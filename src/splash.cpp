#include <Adafruit_SSD1306.h>
#include <Arduino.h>

#include <Fonts/Picopixel.h>

// Logo Specifications ---
#define LOGO_W 38
#define LOGO_H 48

// Inframote Logo Bitmap
const unsigned char logo_bitmap[] PROGMEM = {
    0x00, 0x38, 0x00, 0x70, 0x00, 0x00, 0x3c, 0x00, 0xf0, 0x00, 0x00, 0x1e,
    0x01, 0xe0, 0x00, 0x00, 0x0f, 0xff, 0xc0, 0x00, 0x00, 0x1f, 0xff, 0xe0,
    0x00, 0x00, 0x3f, 0xff, 0xf0, 0x00, 0x00, 0x7f, 0xff, 0xf8, 0x00, 0x00,
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    0xe0, 0x00, 0x00, 0x07, 0xff, 0xc0, 0x00, 0x00, 0x01, 0xff, 0x00, 0x00};

// Arduino codes ---------------

void loadAnimatedSplashScreen(Adafruit_SSD1306* display, uint16_t color,
                      uint16_t bgColor) {
  // Moving Logo from middle to left
  for (int x = 44; x >= 4; x -= 4) {
    display->clearDisplay();
    if (bgColor == 1) {
      display->fillScreen(bgColor);
    }
    display->drawBitmap(x, 6, logo_bitmap, LOGO_W, LOGO_H, color);
    display->display();
  }

  // Text Configuration
  display->setTextWrap(false);
  display->setTextColor(color);
  display->setFont(&Picopixel);
  display->setTextSize(2);

  // INFRAMOTE text animation
  display->setCursor(48, 30);
  char brandName[][2] = {"I", "N", "F", "R", "A", "M", "O", "T", "E"};
  for (auto c : brandName) {
    display->print(c);
    display->display();
    delay(10);
  }

  // Loading Container
  display->drawRoundRect(48, 38, 72, 9, 20, color);
  display->display();
  // Loading Animation
  for (int load = 0, cursorX = 50; load <= 22; cursorX += 3, load++) {
    display->fillRoundRect(cursorX, 40, 2, 5, 20, color);
    display->display();
    delay(50);
  }
}

void loadWelcomeText(Adafruit_SSD1306* display, uint16_t color,
                      uint16_t bgColor) {
  display->clearDisplay();
  display->setCursor(10, 35);
  display->setTextWrap(false);
  display->setFont(&Picopixel);
  display->setTextSize(3);
  display->setTextColor(color);
  display->fillScreen(bgColor);
  display->print("INFRAMOTE");
  display->display();
}


